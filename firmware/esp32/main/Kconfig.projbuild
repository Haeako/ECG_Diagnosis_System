## firmware/esp32/main/Kconfig.projbuild
```kconfig
menu "ECG Monitor Configuration"

    config ECG_BLE_DEVICE_NAME
        string "BLE device name"
        default "ECG-Monitor"
        help
            Name advertised by the ECG BLE peripheral.

    config ECG_BLE_ADV_INTERVAL_MS
        int "BLE advertising interval (ms)"
        range 20 10240
        default 1000
        help
            Interval between connectable advertising events. One second lowers
            idle radio activity while remaining easy to discover.

    config ECG_PROFILE_AUTOSTART
        bool "Automatically start recording after boot (profiling only)"
        default n
        help
            Starts a recording session two seconds after boot so an unattended
            serial performance capture does not depend on BLE or the button.

endmenu
```
